## meta-testGs/conf/layer.conf
```bitbake
# We have a conf and classes directory, add to BBPATH
BBPATH .= ":${LAYERDIR}"

# We have recipes-* directories, add to BBFILES
BBFILES += "${LAYERDIR}/recipes-*/*/*.bb \
            ${LAYERDIR}/recipes-*/*/*.bbappend"

BBFILE_COLLECTIONS += "meta-testGs"
BBFILE_PATTERN_meta-testGs = "^${LAYERDIR}/"
BBFILE_PRIORITY_meta-testGs = "6"

IMAGE_INSTALL:append = " gstreamer1.0 gstreamer1.0-plugins-base-meta gstreamer1.0-plugins-good-meta gstreamer1.0-plugins-ugly-meta gstreamer1.0-libav"

LAYERDEPENDS_meta-testGs = "core"
LAYERSERIES_COMPAT_meta-testGs = "kirkstone"
```
